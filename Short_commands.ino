
// =============================================================================
//  TJCSS Functions
// =============================================================================

void TJCSS(int line) { // เดิน  TracjCSpeed ไปตามจำนวนที่กำหนดแล้ว TracJC(); เพื่อเตรียมเลีี้ยว
  for (int i = 0; i < line; i++) {
    TracJCSpeed();
  }
  TracJC();
  MotorStop();
}

void TJCSS() { TJCSS(1); } // เหมือนคำสั่ง TJCSS(); แต่จะเป็นการ TracJCSpeed() เพียงครั้งเดียว

void TJCSSL(int line) { // TracJCSpeed ไปก่อน แล้วชลอความเร็วเป็น TracJCSlow(); ในกรณีที่เส้นนั้นหลุดบ่อยๆ
  for (int i = 0; i < line; i++) {
    TracJCSpeed();
  }
  TracJCSlow();
  MotorStop();
}

void TJCSSL() { TJCSSL(1); } // เหมือน TJCSSL(); แต่จำเป็นการ TracJCSpeed(); แค่ครั้งเดียว

void TJCSSL2(int line) { // เป็นการใช้ TracJC(); เพื่อไปแบบ speed ธรรมดา และใช้ TacJCSlow(); ในกรณีที่ต้องผ่านแยกที่หลุดบ่อยๆ
  for (int i = 0; i < line; i++) {
    TracJC();
  }
  TracJCSlow();
  MotorStop();
}

void TJCSSL2() { TJCSSL2(1); }

void TJCSSA(int line, int Tracs) { 
  for (int i = 0; i < line; i++) {
    TracJCSpeed();
  }
  for (int a = 0; a < Tracs; a++) {
    TracJC();
  }
  MotorStop();
}

void TJCSSB(int line, int Tracc) {
  for (int i = 0; i < line; i++) {
    TracJCSpeed();
  }
  for (int a = 0; a < Tracc; a++) {
    TracJCSlow();
  }
  MotorStop();
}


// =============================================================================
//  SERVO , GRIP, PUT Functions
// =============================================================================

void GGU() { arm_down();   delay(100); arm_close(); arm_up(); }
void GGU2(){ arm_cm_2cm(); delay(100); arm_close(); arm_up(); }
void GGU3(){ arm_cm_3cm(); delay(100); arm_close(); arm_up(); }
void GGU4(){ arm_cm_4cm(); delay(100); arm_close(); arm_up(); }
void GGU5(){ arm_cm_5cm(); delay(100); arm_close(); arm_up(); }

void GDP()  { arm_down();   delay(100); arm_open(); arm_up(); }
void GDP1() { arm_cm_2cm(); delay(100); arm_open(); arm_up(); }
void GDP2() { arm_cm_3cm(); delay(100); arm_open(); arm_up(); }
void GDP3() { arm_cm_4cm(); delay(100); arm_open(); arm_up(); }
void GDP4() { arm_cm_5cm(); delay(100); arm_open(); arm_up(); }

/*
 * =============================================================================
 *  ForwardBackward_Shorthand.ino - ฟังก์ชันย่อสำหรับเดินหน้า/ถอยหลัง
 * =============================================================================
 *  
 *  ตารางคำสั่งย่อ - เดินหน้า/ถอยหลัง (Forward/Backward)
 *  
 *  | คำสั่งย่อ | คำสั่งเต็ม | คำอธิบาย |
 *  |----------|-----------|----------|
 *  | FD() | Forward() | เดินหน้า |
 *  | FDD(t) | ForwardDelay(time) | เดินหน้าหน่วงเวลา |
 *  | FST(s,t) | ForwardSpeedTime(speed, time) | เดินหน้าตามเวลา |
 *  | FSD(t) | ForwardSpeedDelay(time) | เดินหน้าเร่งความเร็วหน่วงเวลา |
 *  | BK() | Backward() | ถอยหลัง |
 *  | BKD(t) | BackwardDelay(time) | ถอยหลังหน่วงเวลา |
 *  | BST(s,t) | BackwardSpeedTime(speed, time) | ถอยหลังตามเวลา |
 *  | FJS() | ForwardJCStop() | เดินหน้าเช็คแยกหยุด |
 *  | FJ() | ForwardJC() | เดินหน้าเช็คแยก |
 *  | MS() | MotorStop() | หยุดมอเตอร์ |
 * =============================================================================
 */

//=============================================================================
// ฟังก์ชันย่อ - เดินหน้า (Forward)
//=============================================================================

// FD() - เดินหน้า
void FD() {
  Forward();
}

// FDD(t) - เดินหน้าหน่วงเวลา
void FDD(int time) {
  ForwardDelay(time);
}

// FST(s,t) - เดินหน้าตามความเร็วและเวลา
void FST(int speed, int time) {
  ForwardSpeedTime(speed, time);
}

// FSD(t) - เดินหน้าเร่งความเร็วหน่วงเวลา
void FSD(int time) {
  ForwardSpeedDelay(time);
}

//=============================================================================
// ฟังก์ชันย่อ - ถอยหลัง (Backward)
//=============================================================================

// BK() - ถอยหลัง
void BK() {
  Backward();
}

// BKD(t) - ถอยหลังหน่วงเวลา
void BKD(int time) {
  BackwardDelay(time);
}

// BST(s,t) - ถอยหลังตามความเร็วและเวลา
void BST(int speed, int time) {
  BackwardSpeedTime(speed, time);
}

//=============================================================================
// ฟังก์ชันย่อ - ตรวจจับแยก (Junction Check)
//=============================================================================

// FJS() - เดินหน้าเช็คแยกหยุด
void FJS() {
  ForwardJCStop();
}


//=============================================================================
// ฟังก์ชันย่อ - หยุดมอเตอร์
//=============================================================================

// MS() - หยุดมอเตอร์
void MS() {
  MotorStop();
}
//=============================================================================
// ตัวอย่างการใช้งาน
//=============================================================================
/*

void setup() {
  // ตั้งค่าเริ่มต้น
}

void loop() {
  // ตัวอย่างที่ 1: ใช้คำสั่งย่อ
  FD();           // เดินหน้า
  delay(1000);    
  MS();           // หยุด
  
  // ตัวอย่างที่ 2: เดินหน้าด้วยเวลากำหนด
  FDD(500);       // เดินหน้า 500ms
  MS();
  
  // ตัวอย่างที่ 3: เดินหน้าด้วยความเร็วและเวลา
  FST(60, 300);   // เดินหน้าความเร็ว 60, เวลา 300ms
  
  // ตัวอย่างที่ 4: ถอยหลัง
  BK();
  delay(500);
  MS();
  
  // ตัวอย่างที่ 5: ถอยหลังด้วยความเร็วและเวลา
  BST(50, 400);   // ถอยหลังความเร็ว 50, เวลา 400ms
  
  // ตัวอย่างที่ 6: เดินหน้าจนเจอแยก
  FJS();          // เดินหน้าจนเจอแยกแล้วหยุด
  
  while(1);       // หยุดโปรแกรม
}

*/

/*
 * =============================================================================
 *  Turn_Shorthand.ino - ฟังก์ชันย่อสำหรับเลี้ยว
 * =============================================================================
 *
 *  ตารางคำสั่งย่อ - เลี้ยว (Turn)
 *
 *  | คำสั่งย่อ | คำสั่งเต็ม | คำอธิบาย |
 *  |----------|-----------|----------|
 *  | TL() | TurnLeft() | เลี้ยวซ้าย (ใช้ TurnSpeed) |
 *  | TL(s) | TurnLeft(speed) | เลี้ยวซ้าย กำหนดความเร็ว |
 *  | TR() | TurnRight() | เลี้ยวขวา (ใช้ TurnSpeed) |
 *  | TR(s) | TurnRight(speed) | เลี้ยวขวา กำหนดความเร็ว |
 *  | UTL() | UTurnLeft() | กลับตัวซ้าย (ใช้ TurnSpeed) |
 *  | UTL(s) | UTurnLeft(speed) | กลับตัวซ้าย กำหนดความเร็ว |
 *  | UTR() | UTurnRight() | กลับตัวขวา (ใช้ TurnSpeed) |
 *  | UTR(s) | UTurnRight(speed) | กลับตัวขวา กำหนดความเร็ว |
 *  | LT(s,t) | Left(speed, time) | หมุนซ้ายตามเวลา |
 *  | RT(s,t) | Right(speed, time) | หมุนขวาตามเวลา |
 *  | TLD(s,t) | TurnLeftDelay(speed, time) | เลี้ยวซ้ายหน่วงเวลา |
 *  | TRD(s,t) | TurnRightDelay(speed, time) | เลี้ยวขวาหน่วงเวลา |
 *  | CL(s,t) | CurveLeft(speed, time) | โค้งซ้ายอ้อมสิ่งกีดขวาง |
 *  | CR(s,t) | CurveRight(speed, time) | โค้งขวาอ้อมสิ่งกีดขวาง |
 *  | TLB(s) | TurnLeftBack(speed) | เลี้ยวซ้ายเช็คเซ็นเซอร์หลัง |
 *  | TRB(s) | TurnRightBack(speed) | เลี้ยวขวาเช็คเซ็นเซอร์หลัง |
 *  | TLS(s,n) | TurnLeftSensor(speed, sensor) | เลี้ยวซ้ายจนเจอเซ็นเซอร์ที่กำหนด |
 *  | TRS(s,n) | TurnRightSensor(speed, sensor) | เลี้ยวขวาจนเจอเซ็นเซอร์ที่กำหนด |
 * =============================================================================
 */

//=============================================================================
// ฟังก์ชันย่อ - เลี้ยวซ้าย (Turn Left)
//=============================================================================

// TL() - เลี้ยวซ้าย (ใช้ TurnSpeed)
void TL()
{
  TurnLeft();
}

// TL(s) - เลี้ยวซ้าย กำหนดความเร็ว
void TL(int speed)
{
  TurnLeft(speed);
}

//=============================================================================
// ฟังก์ชันย่อ - เลี้ยวขวา (Turn Right)
//=============================================================================

// TR() - เลี้ยวขวา (ใช้ TurnSpeed)
void TR()
{
  TurnRight();
}

// TR(s) - เลี้ยวขวา กำหนดความเร็ว
void TR(int speed)
{
  TurnRight(speed);
}

//=============================================================================
// ฟังก์ชันย่อ - กลับตัวซ้าย (U-Turn Left)
//=============================================================================

// UTL() - กลับตัวซ้าย (ใช้ TurnSpeed)
void UTL()
{
  UTurnLeft();
}

// UTL(s) - กลับตัวซ้าย กำหนดความเร็ว
void UTL(int speed)
{
  UTurnLeft(speed);
}

//=============================================================================
// ฟังก์ชันย่อ - กลับตัวขวา (U-Turn Right)
//=============================================================================

// UTR() - กลับตัวขวา (ใช้ TurnSpeed)
void UTR()
{
  UTurnRight();
}

// UTR(s) - กลับตัวขวา กำหนดความเร็ว
void UTR(int speed)
{
  UTurnRight(speed);
}

//=============================================================================
// ฟังก์ชันย่อ - หมุนตามเวลา
//=============================================================================

// LT(s,t) - หมุนซ้ายตามเวลา
void LT(int speed, int time)
{
  Left(speed, time);
}

// RT(s,t) - หมุนขวาตามเวลา
void RT(int speed, int time)
{
  Right(speed, time);
}

//=============================================================================
// ฟังก์ชันย่อ - เลี้ยวหน่วงเวลา
//=============================================================================

// TLD(s,t) - เลี้ยวซ้ายหน่วงเวลา
void TLD(int speed, int time)
{
  TurnLeftDelay(speed, time);
}

// TRD(s,t) - เลี้ยวขวาหน่วงเวลา
void TRD(int speed, int time)
{
  TurnRightDelay(speed, time);
}

//=============================================================================
// ฟังก์ชันย่อ - โค้งอ้อมสิ่งกีดขวาง
//=============================================================================

// CL(s,t) - โค้งซ้ายอ้อมสิ่งกีดขวาง
void CL(int speed, int time)
{
  CurveLeft(speed, time);
}

// CR(s,t) - โค้งขวาอ้อมสิ่งกีดขวาง
void CR(int speed, int time)
{
  CurveRight(speed, time);
}

//=============================================================================
// ฟังก์ชันย่อ - เลี้ยวเช็คเซ็นเซอร์หลัง
//=============================================================================

// TLB(s) - เลี้ยวซ้ายเช็คเซ็นเซอร์หลัง
void TLB(int speed)
{
  TurnLeftBack(speed);
}

// TRB(s) - เลี้ยวขวาเช็คเซ็นเซอร์หลัง
void TRB(int speed)
{
  TurnRightBack(speed);
}

//=============================================================================
// ฟังก์ชันย่อ - เลี้ยวจนเจอเซ็นเซอร์ที่กำหนด
//=============================================================================

// TLS(s,n) - เลี้ยวซ้ายจนเจอเซ็นเซอร์ที่กำหนด
void TLS(int speed, int sensor)
{
  TurnLeftSensor(speed, sensor);
}

// TRS(s,n) - เลี้ยวขวาจนเจอเซ็นเซอร์ที่กำหนด
void TRS(int speed, int sensor)
{
  TurnRightSensor(speed, sensor);
}

//=============================================================================
// ตัวอย่างการใช้งาน
//=============================================================================
/*

void setup() {
  // ตั้งค่าเริ่มต้น
  setTurnSpeed(60);
}

void loop() {
  // ตัวอย่างที่ 1: เลี้ยวซ้าย/ขวาพื้นฐาน
  TL();           // เลี้ยวซ้าย (ใช้ TurnSpeed)
  FDD(500);       // เดินหน้า 500ms
  TR();           // เลี้ยวขวา (ใช้ TurnSpeed)

  // ตัวอย่างที่ 2: เลี้ยวด้วยความเร็วที่กำหนด
  TL(50);         // เลี้ยวซ้ายความเร็ว 50
  FST(60, 300);   // เดินหน้า
  TR(50);         // เลี้ยวขวาความเร็ว 50

  // ตัวอย่างที่ 3: กลับตัว U-Turn
  UTL();          // กลับตัวซ้าย
  FDD(500);
  UTR(60);        // กลับตัวขวาความเร็ว 60

  // ตัวอย่างที่ 4: หมุนตามเวลา
  LT(60, 200);    // หมุนซ้ายความเร็ว 60, เวลา 200ms
  FDD(300);
  RT(60, 200);    // หมุนขวาความเร็ว 60, เวลา 200ms

  // ตัวอย่างที่ 5: โค้งอ้อมสิ่งกีดขวาง
  CL(60, 100);    // โค้งซ้ายอ้อมสิ่งกีดขวาง
  FDD(500);
  CR(60, 100);    // โค้งขวาอ้อมสิ่งกีดขวาง

  // ตัวอย่างที่ 6: เลี้ยวเช็คเซ็นเซอร์หลัง
  TLB(50);        // เลี้ยวซ้ายเช็คเซ็นเซอร์หลัง

  // ตัวอย่างที่ 7: เลี้ยวจนเจอเซ็นเซอร์ที่กำหนด
  TLS(60, 2);     // เลี้ยวซ้ายจนเจอเซ็นเซอร์ 2
  TRS(60, 5);     // เลี้ยวขวาจนเจอเซ็นเซอร์ 5

  // ตัวอย่างที่ 8: รวมคำสั่งย่อ
  FDD(500);       // เดินหน้า
  TL();           // เลี้ยวซ้าย
  FDD(300);       // เดินหน้า
  TR();           // เลี้ยวขวา
  FST(70, 400);   // เดินหน้าเร็ว
  MS();           // หยุด

  while(1);       // หยุดโปรแกรม
}

// ตัวอย่างเส้นทางซับซ้อน
void complexPath() {
  FDD(1000);      // เดินหน้า
  TL(60);         // เลี้ยวซ้าย
  FDD(500);
  LT(50, 150);    // หมุนซ้ายเล็กน้อย
  FDD(700);
  TR(60);         // เลี้ยวขวา
  CL(60, 100);    // โค้งซ้าย
  FDD(500);
  UTR();          // กลับตัวขวา
  MS();
}

*/

/*
 * =============================================================================
 *  TracDegree_Shorthand.ino - ฟังก์ชันย่อสำหรับ TracDegree และหมุนตัว
 * =============================================================================
 *
 *  ตารางคำสั่งย่อ - TracDegree (เดินตรงด้วย Gyro)
 *
 *  | คำสั่งย่อ      | คำสั่งเต็ม                               | คำอธิบาย                          |
 *  |---------------|------------------------------------------|-----------------------------------|
 *  | TDST(s,d,t,m) | TracDegreeSpeedTime(speed,deg,time,mode) | เดินตรงด้วย Gyro                  |
 *  | TDSB(s,d,t,m) | TracDegreeSpeedTimeBack(speed,deg,t,m)   | ถอยหลังด้วย Gyro                 |
 *  | TJD(s,d,t,m)  | TracJCDegree(speed,degree,tune,mode)     | เดินจนเจอแยกด้วย Gyro             |
 *  | TJDB(s,d,t,m) | TracJCDegreeBack(speed,degree,tune,mode) | ถอยจนเจอแยกด้วย Gyro              |
 *
 *  ตารางคำสั่งย่อ - หมุนตัว (Spin/Turn with Gyro)
 *
 *  | คำสั่งย่อ    | คำสั่งเต็ม                    | คำอธิบาย                      |
 *  |-------------|-------------------------------|-------------------------------|
 *  | SD(s,d,m)   | SpinDegree(speed,degree,mode) | หมุนตัวตามองศา                |
 *  | SL(s,d)     | SpinLeft(speed,degree)        | หมุนซ้าย                      |
 *  | SR(s,d)     | SpinRight(speed,degree)       | หมุนขวา                       |
 *  | SL(s,d,m)   | SpinLeft(speed,degree,mode)   | หมุนซ้าย (กำหนด mode)         |
 *  | SR(s,d,m)   | SpinRight(speed,degree,mode)  | หมุนขวา (กำหนด mode)          |
 *  | TTH(s,h)    | TurnToHeading(speed,heading)  | หมุนไปทิศที่กำหนด (Absolute)  |
 *  | TTF(s)      | TurnToFront(speed)            | หมุนไปทิศหน้า (0°)            |
 *  | TTB(s)      | TurnToBack(speed)             | หมุนไปทิศหลัง (180°)          |
 *  | TTL(s)      | TurnToLeft(speed)             | หมุนไปทิศซ้าย (-90°)          |
 *  | TTR(s)      | TurnToRight(speed)            | หมุนไปทิศขวา (90°)            |
 *  | SH(d)       | SetHeading(degree)            | ตั้งทิศอ้างอิง                |
 *
 *  หมายเหตุ:
 *  - Mode: 0 = Relative (รีเซ็ตหลังเลี้ยว), 1 = Absolute (0°=หน้า, 90°=ขวา, 180°=หลัง, 270°=ซ้าย)
 *  - degree: องศาที่ต้องการหมุน (บวก=ขวา, ลบ=ซ้าย)
 *  - heading: ทิศที่ต้องการหันไป (Absolute mode)
 * =============================================================================
 */

//=============================================================================
// ฟังก์ชันย่อ - เดินตรงด้วย Gyro (TracDegree)
//=============================================================================

// TDST(s,d,t,m) - เดินตรงด้วย Gyro
void TDST(int speed, int degree, int time, int mode)
{
  TracDegreeSpeedTime(speed, degree, time, mode);
}

// TDSB(s,d,t,m) - ถอยหลังด้วย Gyro
void TDSB(int speed, int degree, int time, int mode)
{
  TracDegreeSpeedTimeBack(speed, degree, time, mode);
}

// TJD(s,d,t,m) - เดินจนเจอแยกด้วย Gyro
void TJD(int speed, int degree, int tuneDelay, int mode)
{
  TracJCDegree(speed, degree, tuneDelay, mode);
}

// TJDB(s,d,t,m) - ถอยจนเจอแยกด้วย Gyro
void TJDB(int speed, int degree, int tuneDelay, int mode)
{
  TracJCDegreeBack(speed, degree, tuneDelay, mode);
}

//=============================================================================
// ฟังก์ชันย่อ - หมุนตัว (Spin/Turn)
//=============================================================================

// SPD(s,d,m) - หมุนตัวตามองศา
void SPD(int speed, int degree, int mode)
{
  SpinDegree(speed, degree, mode);
}

// SL(s,d) - หมุนซ้าย
void SL(int speed, int degree)
{
  SpinLeft(speed, degree);
}

// SR(s,d) - หมุนขวา
void SR(int speed, int degree)
{
  SpinRight(speed, degree);
}

// SL(s,d,m) - หมุนซ้าย (กำหนด mode)
void SL(int speed, int degree, int mode)
{
  SpinLeft(speed, degree, mode);
}

// SR(s,d,m) - หมุนขวา (กำหนด mode)
void SR(int speed, int degree, int mode)
{
  SpinRight(speed, degree, mode);
}

//=============================================================================
// ฟังก์ชันย่อ - หมุนไปทิศที่กำหนด (Absolute Mode)
//=============================================================================

// TTH(s,h) - หมุนไปทิศที่กำหนด (Absolute)
void TTH(int speed, int heading)
{
  TurnToHeading(speed, heading);
}

// TTF(s) - หมุนไปทิศหน้า (0°)
void TTF(int speed)
{
  TurnToFront(speed);
}

// TTB(s) - หมุนไปทิศหลัง (180°)
void TTB(int speed)
{
  TurnToBack(speed);
}

// TTL(s) - หมุนไปทิศซ้าย (-90°)
void TTL(int speed)
{
  TurnToLeft(speed);
}

// TTR(s) - หมุนไปทิศขวา (90°)
void TTR(int speed)
{
  TurnToRight(speed);
}

// SH(d) - ตั้งทิศอ้างอิง
void SH(int degree)
{
  SetHeading(degree);
}

//=============================================================================
// ตัวอย่างการใช้งาน
//=============================================================================
/*

void setup() {
  // ตั้งค่าเริ่มต้น
  SH(0);  // ตั้งทิศอ้างอิง 0° (หน้า)
}

void loop() {
  // ========== ตัวอย่างที่ 1: เดินตรงด้วย Gyro ==========
  TDST(60, 0, 1000, 0);     // เดินตรง 0° ความเร็ว 60, 1 วินาที, Relative mode
  SL(50, 90);                // หมุนซ้าย 90°
  TDST(60, 0, 800, 0);      // เดินตรงต่อ

  // ========== ตัวอย่างที่ 2: เดินตรง Absolute Mode ==========
  SH(0);                     // ตั้งทิศอ้างอิง
  TDST(60, 0, 1000, 1);     // เดินหน้า (0°)
  SR(50, 90, 1);             // หมุนขวา 90° (Absolute)
  TDST(60, 90, 800, 1);     // เดินไปทิศขวา (90°)
  SR(50, 90, 1);             // หมุนต่อ (รวม 180°)
  TDST(60, 180, 500, 1);    // เดินถอยหลัง

  // ========== ตัวอย่างที่ 3: หมุนไปทิศที่กำหนด ==========
  TTF(50);                   // หมุนไปทิศหน้า (0°)
  TDST(60, 0, 500, 1);      // เดินหน้า
  TTR(50);                   // หมุนไปทิศขวา (90°)
  TDST(60, 90, 500, 1);     // เดินไปทิศขวา
  TTB(50);                   // หมุนไปทิศหลัง (180°)
  TDST(60, 180, 500, 1);    // เดินถอยหลัง
  TTL(50);                   // หมุนไปทิศซ้าย (-90°)
  TDST(60, -90, 500, 1);    // เดินไปทิศซ้าย

  // ========== ตัวอย่างที่ 4: เดินจนเจอแยก ==========
  TJD(60, 0, 50, 0);        // เดินตรงจนเจอแยก, tune 50ms
  SL(50, 90);                // หมุนซ้าย 90°
  TJD(60, 0, 50, 0);        // เดินต่อจนเจอแยกอีก

  // ========== ตัวอย่างที่ 5: ถอยหลังด้วย Gyro ==========
  TDSB(50, 0, 800, 0);      // ถอยหลัง 800ms
  SR(50, 90);                // หมุนขวา 90°
  TDSB(50, 0, 600, 0);      // ถอยหลังต่อ

  // ========== ตัวอย่างที่ 6: ถอยหลังจนเจอแยก ==========
  TJDB(50, 0, 50, 0);       // ถอยหลังจนเจอแยก

  // ========== ตัวอย่างที่ 7: หมุนตามองศาแบบ Relative ==========
  SD(50, 45, 0);            // หมุนขวา 45° (Relative)
  TDST(60, 0, 500, 0);      // เดินตรง
  SD(50, -45, 0);           // หมุนซ้าย 45° (Relative)
  TDST(60, 0, 500, 0);      // เดินตรง

  // ========== ตัวอย่างที่ 8: เดินทางซับซ้อนด้วย Absolute Mode ==========
  SH(0);                     // ตั้งทิศอ้างอิง
  TDST(70, 0, 1000, 1);     // เดินหน้า
  SR(60, 45, 1);             // หมุนขวา 45°
  TDST(70, 45, 800, 1);     // เดินไปมุม 45°
  SR(60, 45, 1);             // หมุนขวาอีก 45° (รวม 90°)
  TDST(70, 90, 800, 1);     // เดินไปทิศขวา
  TTH(60, 0);                // หมุนกลับไปทิศหน้า
  TDST(70, 0, 500, 1);      // เดินหน้า

  MS();                      // หยุด
  while(1);
}

// ตัวอย่าง: เดินเป็นรูปสี่เหลี่ยมด้วย Absolute Mode
void squarePath() {
  SH(0);                     // ตั้งทิศอ้างอิง

  // ด้านที่ 1: เดินหน้า
  TDST(60, 0, 1000, 1);
  TTR(50);                   // หมุนไปทิศขวา

  // ด้านที่ 2: เดินไปทิศขวา
  TDST(60, 90, 1000, 1);
  TTB(50);                   // หมุนไปทิศหลัง

  // ด้านที่ 3: เดินถอยหลัง
  TDST(60, 180, 1000, 1);
  TTL(50);                   // หมุนไปทิศซ้าย

  // ด้านที่ 4: เดินไปทิศซ้าย
  TDST(60, -90, 1000, 1);
  TTF(50);                   // หมุนกลับไปทิศหน้า

  MS();
}

// ตัวอย่าง: เดินเป็นรูปดาวด้วย Relative Mode
void starPath() {
  for (int i = 0; i < 5; i++) {
    TDST(60, 0, 800, 0);    // เดินตรง
    SR(50, 144);             // หมุนขวา 144° (360°/5 * 2)
  }
  MS();
}

// ตัวอย่าง: เดินหาเป้าหมายด้วยแยก
void junctionPath() {
  TJD(60, 0, 50, 0);        // เดินจนเจอแยกแรก
  SL(50, 90);                // เลี้ยวซ้าย
  TJD(60, 0, 50, 0);        // เดินจนเจอแยกที่สอง
  SR(50, 90);                // เลี้ยวขวา
  TDST(60, 0, 500, 0);      // เดินหน้าต่อ
  MS();
}

*/